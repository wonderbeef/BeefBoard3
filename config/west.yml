## config/west.yml
```yaml
manifest:
  remotes:
    - name: zmkfirmware
      url-base: https://github.com/zmkfirmware
    - name: Cyboard-DigitalTailor
      url-base: https://github.com/Cyboard-DigitalTailor
    # Additional modules containing boards/shields/custom code can be listed here as well
    # See https://docs.zephyrproject.org/3.2.0/develop/west/manifest.html#projects
  projects:
    - name: zmk
      remote: zmkfirmware
      # Pinned to the latest stable ZMK release, matching the Cyboard Studio
      # firmware stack. To track current ZMK main (Zephyr 4.1) instead, set
      # this to main and use the zephyr-4.1 branch of zmk-keyboards below.
      revision: v0.3.0
      import: app/west.yml
    - name: zmk-keyboards
      remote: Cyboard-DigitalTailor
      revision: main
      import: config/west.yml
  self:
    path: config
```
